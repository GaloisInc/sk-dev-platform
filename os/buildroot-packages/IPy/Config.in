## os/buildroot-packages/IPy/Config.in
```kconfig
config BR2_PACKAGE_IPY
	bool "ipy"
	help
	  Class and tools for handling of IPv4 and IPv6 addresses and networks

          http://pypi.python.org/pypi/IPy
```

## os/buildroot-packages/checkpolicy/Config.in
```kconfig
config BR2_PACKAGE_CHECKPOLICY
	bool "checkpolicy"
	help
	  SELinux policy checker

          http://userspace.selinuxproject.org/trac
```

## os/buildroot-packages/libcap-ng/Config.in
```kconfig
config BR2_PACKAGE_LIBCAP_NG
	bool "libcap-ng"
	help
	  Capabilities library used by policycoreutils

          http://people.redhat.com/sgrubb/libcap-ng/
```

## os/buildroot-packages/libcg/Config.in
```kconfig
config BR2_PACKAGE_LIBCG
	bool "libcg"
	help
	  Linux kernel control groups userspace library and utilities

	  http://libcg.sourceforge.net/
```

## os/buildroot-packages/libdeadline/Config.in
```kconfig
config BR2_PACKAGE_LIBDEADLINE
	bool "libdeadline"
	help
	  Shared library for using the Linux deadline scheduling
	  system call API

          http://gitorious.org/sched_deadline/libdl
```

## os/buildroot-packages/libselinux/Config.in
```kconfig
config BR2_PACKAGE_LIBSELINUX
	bool "libselinux"
        depends on BR2_PACKAGE_LIBSEPOL
        depends on BR2_PACKAGE_PCRE
	help
	  SELinux development headers necessary for building Busybox
	  with SELinux support

          http://userspace.selinuxproject.org/trac
```

## os/buildroot-packages/libsemanage/Config.in
```kconfig
config BR2_PACKAGE_LIBSEMANAGE
	bool "libsemanage"
        depends on BR2_PACKAGE_USTR
	help
	  libsemanage

          http://userspace.selinuxproject.org/trac
```

## os/buildroot-packages/libsepol/Config.in
```kconfig
config BR2_PACKAGE_LIBSEPOL
	bool "libsepol"
	help
	  SELinux policy development headers necessary for building
	  Busybox with SELinux support

          http://userspace.selinuxproject.org/trac
```

## os/buildroot-packages/policycoreutils/Config.in
```kconfig
config BR2_PACKAGE_POLICYCOREUTILS
	bool "policycoreutils"
        depends on BR2_PACKAGE_LIBSEPOL && BR2_PACKAGE_LIBSELINUX && BR2_PACKAGE_LIBCAP_NG && BR2_PACKAGE_LIBSEMANAGE
        select BR2_PACKAGE_GETTEXT if BR2_NEEDS_GETTEXT
        select BR2_PACKAGE_LIBGLIB2
	help
	  SELinux policy utilities

          http://userspace.selinuxproject.org/trac
```

## os/buildroot-packages/refpolicy/Config.in
```kconfig
config BR2_PACKAGE_REFPOLICY
       bool "refpolicy"
       depends on BR2_PACKAGE_CHECKPOLICY && BR2_PACKAGE_LIBSEPOL && BR2_PACKAGE_LIBSEMANAGE && BR2_PACKAGE_POLICYCOREUTILS
       help
         SELinux reference policy

          http://userspace.selinuxproject.org/trac
```

## os/buildroot-packages/schedtool-dl/Config.in
```kconfig
config BR2_PACKAGE_SCHEDTOOL_DL
	bool "schedtool-dl"
        depends on BR2_PACKAGE_LIBDEADLINE
	help
	  Modified 'schedtool' program for use with the Linux deadline
	  scheduler

          http://gitorious.org/sched_deadline/schedtool-dl
```

## os/buildroot-packages/sepolgen/Config.in
```kconfig
config BR2_PACKAGE_SEPOLGEN
	bool "sepolgen"
	help
	  SELinux policy generator

          http://userspace.selinuxproject.org/trac
```

## os/buildroot-packages/ustr/Config.in
```kconfig
config BR2_PACKAGE_USTR
	bool "ustr"
	help
	  uStr string library

          http://www.and.org/ustr/
```

## os/configs/ext3/Config.in
```kconfig
config BR2_TARGET_ROOTFS_EXT3
	bool "ext3 root filesystem"
	help
	  Build an ext3 root filesystem
```
